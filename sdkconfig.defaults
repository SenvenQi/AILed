## sdkconfig.defaults
```kconfig
# Flash (16MB, QIO)
CONFIG_ESPTOOLPY_FLASHSIZE_16MB=y
CONFIG_ESPTOOLPY_FLASHMODE_QIO=y
CONFIG_ESPTOOLPY_FLASHFREQ_80M=y

# PSRAM (8MB, Octal SPI)
CONFIG_SPIRAM=y
CONFIG_SPIRAM_MODE_OCT=y
CONFIG_SPIRAM_SPEED_80M=y
CONFIG_SPIRAM_BOOT_INIT=y
CONFIG_SPIRAM_MALLOC_ALWAYSINTERNAL=4096
CONFIG_SPIRAM_TRY_ALLOCATE_WIFI_LWIP=y
CONFIG_SPIRAM_MALLOC_RESERVE_INTERNAL=32768

# Partition Table (custom, 16MB)
CONFIG_PARTITION_TABLE_CUSTOM=y
CONFIG_PARTITION_TABLE_CUSTOM_FILENAME="partitions.csv"

# HTTP Client
CONFIG_ESP_HTTP_CLIENT_ENABLE_HTTPS=y

# Bluetooth provisioning
CONFIG_BT_ENABLED=y
CONFIG_BT_BLUEDROID_ENABLED=y
CONFIG_BT_BLE_ENABLED=y
CONFIG_BT_BLE_42_FEATURES_SUPPORTED=y

# WebSocket
CONFIG_WS_TRANSPORT=y

# FreeRTOS
CONFIG_FREERTOS_HZ=1000

# Allow task stacks in PSRAM
CONFIG_SPIRAM_ALLOW_STACK_EXTERNAL_MEMORY=y

# Main task stack
CONFIG_ESP_MAIN_TASK_STACK_SIZE=8192

# Stack overflow detection
CONFIG_FREERTOS_WATCHPOINT_END_OF_STACK=y

# LWIP
CONFIG_LWIP_MAX_SOCKETS=16
```
